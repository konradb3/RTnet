## drivers/experimental/Kconfig
```kconfig
config RTNET_EXP_DRIVERS
    bool "Experimental Drivers"

if RTNET_EXP_DRIVERS

config RTNET_DRV_3C59X
    bool "3Com 59x"

config RTNET_DRV_E1000_NEW
    bool "New Intel(R) PRO/1000 (Gigabit)"

source "drivers/experimental/rt2500/Kconfig"

endif
```

## examples/Kconfig
```kconfig
menu "Examples"

config RTNET_EXAMPLES
    bool "RTnet Application Examples"
    default n
    ---help---
    Compile various example applications for RTnet, depending on the RTAI
    version you are building for. Note that these examples will not be
    installed to the RTnet destination folder, the binaries will remain in
    the build tree.

config RTNET_RTEXT_CONFIG_PATH
    string "Real-time Extension Config-Tool Path"
    default ""
    depends RTNET_RTEXT_INKERNEL && RTNET_EXAMPLES
    ---help---
    Path to the configuration tool of the installed real-time Linux
    extension. This is only required if the configuration tool is not
    reachable via standard $PATH.

endmenu
```

## rtnet/Kconfig
```kconfig
config RTNET_VERSION
    string
    default "0.9.8"

mainmenu "RTnet Configuration"

comment "Real-Time Extension"

choice
    prompt "Variant"
    default RTNET_RTEXT_INKERNEL

config RTNET_RTEXT_CLASSIC
    bool "RTAI 3.3-cv or better, Xenomain 2.0.x"

config RTNET_RTEXT_INKERNEL
    bool "Xenomai 2.1 or better"

endchoice

config RTNET_RTEXT_DIR
    string "Real-Time Extension Installation Path"
    default "/usr/realtime"
    depends RTNET_RTEXT_CLASSIC
    ---help---
    Path to an installed version of the real-time Linux extension.
    Xenomai and RTAI are supported. Do not confuse with the source
    code directory of the extension.

config RTNET_LINUX_DIR
    string "Real-Time Extended Linux Kernel"
    default "/lib/modules/`uname -r`/build"
    depends RTNET_RTEXT_INKERNEL
    ---help---
    Path to a Linux kernel source tree which has been extended by
    Xenomai with a real-time subsystem. Since Xenomai 2.1 (or better)
    strictly separates the kernelspace from the userspace source tree,
    there is no longer a direct link between the CONFIG_RTNET_RTEXT_DIR
    and CONFIG_RTNET_LINUX_DIR.

comment "RTnet Parameters"

config RTNET_INSTALLDIR
    string "Installation Path of RTnet"
    default "/usr/local/rtnet"
    ---help---
    Destination path where RTnet's binaries, configuration files, and
    headers shall be installed.

config RTNET_CHECKED
    bool "Internal Bug Checks"
    default n
    ---help---
    Switch on if you face crashes when RTnet is running or if you suspect
    any other RTnet-related issues. This feature will add a few sanity
    checks at critical points that will produce warnings on the kernel
    console in case certain internal bugs are detected.

source "stack/Kconfig"
source "drivers/Kconfig"
source "addons/Kconfig"
source "examples/Kconfig"
```

## rtnet/addons/Kconfig
```kconfig
menu "Add-Ons"

config RTNET_ADDON_RTCAP
    bool "Real-Time Capturing Support"
    default n
    ---help---
    This feature allows to capture real-time packets traversing the RTnet
    stack. It can both be used to sniff passively on a network (in this
    case you may want to enable the promisc mode of your real-time NIC via
    rtifconfig) and to log the traffic the node receives and transmits
    during normal operation. RTcap consists of additional hooks in the
    RTnet stack and a separate module as interface to standard network
    analysis tools like Ethereal.

    For further information see Documentation/README.rtcap.

config RTNET_ADDON_PROXY
    bool "IP protocol proxy (legacy)"
    depends on RTNET_RTIPV4
    default n
    ---help---
    Enables a forward-to-Linux module for all IP protocols that are not
    handled by the IPv4 implemenation of RTnet (e.g. TCP). Only use when
    you know what you are doing - it can easily break your real-time
    requirements!

    See Documentation/README.rtnetproxy for further information.

endmenu
```

## rtnet/config.in
```kconfig
# Use SCCx or FEC Ethernet for RTnet on MPC 8xx
if [ "$CONFIG_8xx" = "y" ]; then
  if [ "$CONFIG_SCC_ENET" != "y" ]; then
    bool 'CPM SCC Ethernet' CONFIG_RTAI_RTNET_SCC_ENET
    if [ "$CONFIG_RTAI_RTNET_SCC_ENET" = "y" ]; then
      choice 'SCC used for Ethernet' \
  	  "SCC1   CONFIG_RTAI_RTNET_SCC1_ENET  \
  	   SCC2   CONFIG_RTAI_RTNET_SCC2_ENET  \
  	   SCC3   CONFIG_RTAI_RTNET_SCC3_ENET" SCC1
    else
      define_bool CONFIG_RTAI_RTNET_SCC1_ENET n
      define_bool CONFIG_RTAI_RTNET_SCC2_ENET n
      define_bool CONFIG_RTAI_RTNET_SCC3_ENET n
    fi
  fi
  if [ "$CONFIG_FEC_ENET" != "y" ]; then
    bool 'CPM FEC Ethernet' CONFIG_RTAI_RTNET_FEC_ENET
  fi
fi

# Use FCCx for RTnet on MPC 8260
if [ "$CONFIG_8260" = "y" ]; then
  bool 'CPM FCC Ethernet' CONFIG_RTAI_RTNET_FCC_ENET
  if [ "$CONFIG_RTAI_RTNET_FCC_ENET" = "y" ]; then
    if [ "CONFIG_FCC1_ENET" != "y" ]; then
      bool 'Ethernet on FCC1' CONFIG_RTAI_RTNET_FCC1_ENET
      if [ "$CONFIG_PM826" = "y" ]; then
        bool '  DB CR826 Legacy Jumper ON' CONFIG_RTAI_RTNET_DB_CR826_J30x_ON
      fi
    fi
    if [ "CONFIG_FCC2_ENET" != "y" ]; then
      bool 'Ethernet on FCC2' CONFIG_RTAI_RTNET_FCC2_ENET
    fi
    if [ "CONFIG_FCC3_ENET" != "y" ]; then
      bool 'Ethernet on FCC3' CONFIG_RTAI_RTNET_FCC3_ENET
    fi
  fi
fi
```

## rtnet/drivers/Kconfig
```kconfig
menu "Drivers"

comment "Common PCI Drivers"

config RTNET_DRV_PCNET32
    bool "AMD PCnet32"
    default n


config RTNET_DRV_TULIP
    bool "DEC Tulip"
    default n


config RTNET_DRV_EEPRO100
    bool "Intel EtherExpress PRO/100"
    default y

config RTNET_DRV_EEPRO100_CMDTIMEOUT
    int "Command Timeout"
    depends RTNET_DRV_EEPRO100
    default 20
    ---help---
    Timeout in microseconds of transmission or configuration commands that
    are issued in real-time contexts.

config RTNET_DRV_EEPRO100_DBG
    bool "Enable debugging and instrumentation"
    depends RTNET_DRV_EEPRO100
    default n
    ---help---
    This option switches on internal debugging code of the EEPRO/100 driver.
    It also enables the collection of worst-case command delays in real-time
    contexts in order to reduce the command timeout (which, effectively, will
    also reduce the worst-case transmission latency).


config RTNET_DRV_NATSEMI
    bool "NatSemi"
    default n


config RTNET_DRV_8139
    bool "Realtek 8139"
    default y


config RTNET_DRV_VIA_RHINE
    bool "VIA Rhine"
    default n


if ARCH = ppc

comment "Embedded MPC Drivers"

config RTNET_DRV_FCC_ENET
    bool "MPC8260 FCC Ethernet"
    default n


config RTNET_DRV_FEC_ENET
    bool "MPC8xx FEC Ethernet"
    default n


config RTNET_DRV_SCC_ENET
    bool "MPC8xx SCC Ethernet"
    default n


config RTNET_DRV_MPC52XX_FEC
    bool "MPC52xx FEC Ethernet"
    default n

endif


comment "Misc Drivers"

config RTNET_DRV_LOOPBACK
    bool "Loopback"
    default y


config RTNET_DRV_SMC91111
    bool "SMSC LAN91C111"
    default n


config RTNET_DRV_ETH1394
    bool "Ethernet over 1394"
    default n


config RTFIREWIRE_DIR
    string "Path of RT-FireWire Source Code"
    depends on RTNET_DRV_ETH1394
    default "/usr/local/rt-firewire"


source "drivers/experimental/Kconfig"

endmenu
```

## rtnet/drivers/experimental/Kconfig
```kconfig
config RTNET_EXP_DRIVERS
    bool "Experimental Drivers"

config RTNET_DRV_3C59X
    bool "3Com 59x"
    depends on RTNET_EXP_DRIVERS

config RTNET_DRV_R8169
    bool "Realtek 8169 (Gigabit)"
    depends on RTNET_EXP_DRIVERS

source "drivers/experimental/rt2500/Kconfig"
source "drivers/experimental/e1000/Kconfig"
```

## rtnet/drivers/experimental/e1000/Kconfig
```kconfig
config RTNET_DRV_E1000
    bool "Intel(R) PRO/1000 (Gigabit)"
    depends on RTNET_EXP_DRIVERS
```

## rtnet/examples/Kconfig
```kconfig
menu "Examples"

config RTNET_EXAMPLES
    bool "RTnet Application Examples"
    default n
    ---help---
    Compile various example applications for RTnet, depending on the RTAI
    version you are building for. Note that these examples will not be
    installed to the RTnet destination folder, the binaries will remain in
    the build tree.

config RTNET_RTEXT_CONFIG_PATH
    string "Real-time Extension Installation Path"
    default ""
    depends RTNET_RTEXT_INKERNEL && RTNET_EXAMPLES
    ---help---
    Path to an installed version of the real-time Linux extension. This
    is only required if the required configuration tool is not reachable
    via standard $PATH. Do not confuse with the source code directory of
    the extension.

endmenu
```

## rtnet/stack/Kconfig
```kconfig
menu "Protocol Stack"

comment "Stack parameters"

config RTNET_RX_FIFO_SIZE
    int "Size of central RX-FIFO"
    default 32
    ---help---
    Size of FIFO between NICs and stack manager task. Must be power
    of two! Effectively, only CONFIG_RTNET_RX_FIFO_SIZE-1 slots will
    be usable.

config RTNET_ETH_P_ALL
    bool "Support for ETH_P_ALL"
    ---help---
    Enables core support for registering listeners on all layer 3
    protocols (ETH_P_ALL). Internally this is currently realised by
    clone-copying incoming frames for those listners, future versions
    will implement buffer sharing for efficiency reasons. Use with
    care, every ETH_P_ALL-listener adds noticable overhead to the
    reception path.

config RTNET_RTWLAN
    bool "Real-Time WLAN"
    ---help---
    Enables core support for real-time wireless LAN. RT-WLAN is based
    on low-level access to 802.11-compliant adapters and is currently
    in an experimental stage.

comment "Protocols"

source "stack/ipv4/Kconfig"
source "stack/packet/Kconfig"
source "stack/rtmac/Kconfig"
source "stack/rtcfg/Kconfig"

endmenu
```

## rtnet/stack/ipv4/Kconfig
```kconfig
config RTNET_RTIPV4
    bool "Real-Time IPv4"
    default y
    ---help---
    Enables the real-time capable IPv4 support of RTnet. The protocol is
    implemented as a separate module. Supplementing tools (rtroute,
    rtping) and examples are provided as well. Moreover, RTcfg will
    include IPv4 support when this option is switched on.

    For further information see also Documentation/README.routing and
    Documentation/README.ipfragmentation.

config RTNET_RTIPV4_ROUTE_SRC
    bool "Consider source IP for output routing"
    depends on RTNET_RTIPV4
    ---help---
    When enabled, RTnet will also consider the local interface IP while
    looking up a destination host route. This effectively allows to maintain
    host routes for different network interfaces with identical IP addresses.

    Normal RTnet setups are expected to use only unique IP addresses, thus
    this option can be left disabled in that case to avoid (low) overhead.

config RTNET_RTIPV4_NETROUTING
    bool "IP Network Routing"
    depends on RTNET_RTIPV4
    ---help---
    Enables routing across IPv4 real-time networks. You will only require
    this feature in complex networks, while switching it off for flat,
    single-segment networks improves code size and the worst-case routing
    decision delay.

    See Documentation/README.routing for further information.

config RTNET_RTIPV4_ROUTER
    bool "IP Router"
    depends on RTNET_RTIPV4
    ---help---
    When switched on, the RTnet station will be able to forward IPv4
    packets that are not directed to the station itself. Typically used in
    combination with CONFIG_RTNET_RTIPV4_NETROUTING.

    See Documentation/README.routing for further information.
```

## rtnet/stack/rtcfg/Kconfig
```kconfig
config RTNET_RTCFG
    bool "RTcfg Service"
    default y

config RTNET_RTCFG_DEBUG
    bool "RTcfg Debugging"
    depends on RTNET_RTCFG
    default n
```

## rtnet/stack/rtmac/Kconfig
```kconfig
menuconfig RTNET_RTMAC
    bool "RTmac Layer"
    default y
    ---help---
    The Real-Time Media Access Control layer allows to extend the RTnet
    stack with software-based access control mechanisms (also called
    disciplines) for nondeterministic transport media. Disciplines can be
    attached and detached per real-time device. RTmac also provides a
    framework for tunnelling non-time-critical packets through real-time
    networks by installing virtual NICs (VNIC) in the Linux domain.

    See Documentation/README.rtmac for further information.

source "stack/rtmac/tdma/Kconfig"
source "stack/rtmac/nomac/Kconfig"
```

## rtnet/stack/rtmac/nomac/Kconfig
```kconfig
config RTNET_NOMAC
    bool "NoMAC discipline for RTmac"
    depends RTNET_RTMAC
    default n
    ---help---
    This no-operation RTmac discipline is intended to act as a template
    for new implementations. However, it can be compiled and used (see
    nomaccfg management tool), but don't expect any improved determinism
    of your network. ;)
```

## rtnet/stack/rtmac/tdma/Kconfig
```kconfig
config RTNET_TDMA
    bool "TDMA discipline for RTmac"
    depends RTNET_RTMAC
    default y
    ---help---
    The Time Division Multiple Access discipline is the default RTmac
    protocol for Ethernet networks. It consists of a master synchronising
    the access of the slaves to the media by periodically issuing frames.
    Backup masters can be set up to take over if the primary master fails.
    TDMA also provides a global clock across all participants. The tdmacfg
    tool can be used to configure a real-time NIC to use TDMA.

    See Documenatation/README.rtmac for further details.

config RTNET_TDMA_MASTER
    bool "TDMA master support"
    depends RTNET_TDMA
    default y
    ---help---
    Enables TDMA master and backup master support for the node. This can
    be switched of to reduce the memory footprint of pure slave nodes.
```

## stack/ipv4/tcp/Kconfig
```kconfig
config RTNET_RTIPV4_TCP
    bool "TCP support"
    depends on RTNET_RTIPV4
    default y
    ---help---
    Enables TCP support of the RTnet Real-Time IPv4 protocol.

    When the RTnet IPv4 is enabled while this feature is disabled, TCP
    will be forwarded to the Linux network stack.
```

## stack/ipv4/udp/Kconfig
```kconfig
config RTNET_RTIPV4_UDP
    bool "UDP support"
    depends on RTNET_RTIPV4
    default y
    ---help---
    Enables UDP support of the RTnet Real-Time IPv4 protocol.
```
